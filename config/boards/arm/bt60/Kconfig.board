## config/boards/arm/bt60/bt60_defconfig
```kconfig
# SPDX-License-Identifier: MIT
# Hardware Vendor settings (Don't touch!)

CONFIG_SOC_SERIES_NRF52X=y
CONFIG_SOC_NRF52840_QIAA=y
CONFIG_BOARD_BT60=y

# Firmware
CONFIG_ARM_MPU=y
CONFIG_GPIO=y
CONFIG_USE_DT_CODE_PARTITION=y

# Encoder
CONFIG_EC11=y
CONFIG_EC11_TRIGGER_GLOBAL_THREAD=y

CONFIG_MPU_ALLOW_FLASH_WRITE=y
CONFIG_NVS=y
CONFIG_SETTINGS_NVS=y
CONFIG_FLASH=y
CONFIG_FLASH_PAGE_LAYOUT=y
CONFIG_FLASH_MAP=y

# Use the STRIP config specific to the LEDs you're using
CONFIG_WS2812_STRIP=y
CONFIG_BT_CTLR_TX_PWR_PLUS_8=y
CONFIG_PWM=y
CONFIG_LED_PWM=y
CONFIG_ZMK_BACKLIGHT=y
CONFIG_BUILD_OUTPUT_UF2=y

## LED STRIP config
CONFIG_WS2812_STRIP=y
CONFIG_BT_CTLR_TX_PWR_PLUS_8=y
CONFIG_PWM=y
CONFIG_LED_PWM=y
CONFIG_ZMK_BACKLIGHT=y
CONFIG_BUILD_OUTPUT_UF2=y

# Underglow
## General
CONFIG_ZMK_RGB_UNDERGLOW=y
CONFIG_ZMK_RGB_UNDERGLOW_EXT_POWER=y
CONFIG_ZMK_RGB_UNDERGLOW_ON_START=n

## User
CONFIG_ZMK_RGB_UNDERGLOW_HUE_START=190
CONFIG_ZMK_RGB_UNDERGLOW_SAT_START=50
CONFIG_ZMK_RGB_UNDERGLOW_BRT_START=30
CONFIG_ZMK_RGB_UNDERGLOW_SPD_START=2
CONFIG_ZMK_RGB_UNDERGLOW_EFF_START=1

# Idling behaviour
# CONFIG_ZMK_IDLE_TIMEOUT=30000
# CONFIG_ZMK_RGB_UNDERGLOW_AUTO_OFF_IDLE=y
```
